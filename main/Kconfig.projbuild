## main/Kconfig.projbuild
```kconfig
menu "Mochi"

    config MOCHI_DEEP_SLEEP_TIMEOUT_SEC
        int "Deep sleep inactivity timeout (seconds)"
        range 30 3600
        default 60
        help
            Seconds of inactivity before the device enters deep sleep.
            Default is 60 (1 minute). A press of the knob button wakes it.

    config MOCHI_REC_MAX_SEC
        int "Maximum recording length (seconds)"
        range 5 3600
        default 600
        help
            A click of the knob button starts recording to the SD card and
            the next click saves it. This is the backstop for a recording
            nobody comes back to stop: it is closed and saved on its own
            once it reaches this length. 16 kHz mono is about 2 MB a minute.

    config MOCHI_SCENE_DWELL_SEC
        int "Seconds a scene holds before the pond moves on"
        range 0 3600
        default 180
        help
            How long the pond stays in one time of day and one weather
            before it turns to the next. Six hours run round in order
            (dawn, morning, noon, afternoon, dusk, night) and the sky is
            rolled again on every one of them, so at the default of 180
            the pond gets through a full day in about 18 minutes.

            The turn itself is crossfaded over about six seconds, so a
            dwell of only a few seconds gives a pond permanently in the
            middle of changing. 0 holds whichever scene it opened on.

            Recording holds the clock: the pond's day waits while it is
            listening, and picks up where it left off afterwards.

    config MOCHI_POND_KOI_COUNT
        int "Number of koi in the pond"
        range 1 12
        default 8
        help
            How many koi to simulate at boot. They cycle through three
            colourways, and roam past the rim, so the number visible on
            screen drifts either side of this. Changeable at runtime with
            pond_set_population().

    config MOCHI_POND_LILY_COUNT
        int "Number of lily pads"
        range 0 12
        default 5
        help
            How many lily pads to simulate at boot. They are scattered
            randomly on every boot and drift around afterwards. Set to 0
            for open water.

    config MOCHI_POND_MOTE_COUNT
        int "Number of drifting motes"
        range 0 16
        default 7
        help
            Faint glowing specks drifting over the surface. Set to 0 to
            turn them off.

endmenu
```
